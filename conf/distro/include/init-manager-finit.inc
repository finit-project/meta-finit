## conf/distro/include/init-manager-finit.inc
```bitbake
VIRTUAL-RUNTIME_init_manager ??= "finit"
VIRTUAL-RUNTIME_initscripts ??= "finitscripts"
VIRTUAL-RUNTIME_login_manager ??= "busybox"
VIRTUAL-RUNTIME_dev_manager = ""
VIRTUAL-RUNTIME_base-utils-hwclock = ""

PREFERRED_RPROVIDER_initd-functions = "finitscripts"

# finit does not support volatile implementation from OE, disable volatile log
VOLATILE_LOG_DIR = "no"
```

## conf/layer.conf
```bitbake
# We have a conf and classes directory, add to BBPATH
BBPATH .= ":${LAYERDIR}"

# We have recipes-* directories, add to BBFILES
BBFILES += "${LAYERDIR}/recipes-*/*/*.bb \
	${LAYERDIR}/recipes-*/*/*.bbappend"

BBFILES_DYNAMIC += " \
    openembedded-layer:${LAYERDIR}/dynamic-layers/openembedded-layer/*/*/*.bb \
    openembedded-layer:${LAYERDIR}/dynamic-layers/openembedded-layer/*/*/*.bbappend \
    security:${LAYERDIR}/dynamic-layers/security/*/*/*.bb \
    security:${LAYERDIR}/dynamic-layers/security/*/*/*.bbappend \
"

BBFILE_COLLECTIONS += "finit"
BBFILE_PATTERN_finit = "^${LAYERDIR}/"
BBFILE_PRIORITY_finit = "10"

INHERIT += "finit-sanity"

LAYERSERIES_COMPAT_finit = "scarthgap"
```
